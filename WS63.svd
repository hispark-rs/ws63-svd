# WS63 register map
File version: 1.0
CPU: other r0p0, little endian, MPU, FPU, 3 interrupt priority bits
Registers are 32-bit, read-write, reset 0x0 unless marked. A register's access mark holds for its fields unless they carry their own. Offsets are from the block's base; [hi:lo] are bit positions; lines under a group give offsets from that group; {n}, {i} and the like mark numbered series.

## PWM — PWM controller with 8 channels
Base 0x44024000
0x00 PWM_SEL0 — PWM group 0 select
  [15:0] pwm_sel_0 — Group 0 PWM select, each bit corresponds to one PWM channel
{0x4+0x10*i} PWM_STARTCLRCNT_EN{i} (i=0..3) — PWM group {i} start clear counter enable
  [0] pwm_startclrcnt_en_{i} — Start clear counter enable for group {i}
{0x8+0x10*i} PWM_START{i} wo (i=0..3) — PWM group {i} start
  [0] pwm_start_{i} — Start group {i} (self-clearing)
{0x0+0x10*i} PWM_SEL{i} (i=1..3) — PWM group {i} select
  [15:0] pwm_sel_{i} — Group {i} PWM select
0x100 PWM_EN0 — PWM0 enable
  [0] pwm_en_0 — PWM0 enable: 0=off; 1=on
    0=Off (PWM disabled, output low); 1=On (PWM enabled)
0x104 PWM_PORTITY0 — PWM0 polarity
  [0] pwm_poarity_0 — PWM0 polarity: 0=normal; 1=inverted
    0=Normal polarity; 1=Inverted polarity
0x108 PWM_OEN_CFG0 — PWM0 high-impedance config
  [0] pwm_oen_cfg_0 — PWM0 high-Z enable: 0=follow polarity; 1=high-Z when inactive
0x10C PWM_OFFSET_L0 — PWM0 phase offset low 16 bits
  [15:0] pwm_offset_l_0
0x110 PWM_OFFSET_H0 — PWM0 phase offset high 16 bits
  [15:0] pwm_offset_h_0
0x114 PWM_FREQ_L0 — PWM0 frequency low 16 bits
  [15:0] pwm_freq_l_0 — PWM0 clock divider low 16 bits
0x118 PWM_FREQ_H0 — PWM0 frequency high 16 bits
  [15:0] pwm_freq_h_0 — PWM0 clock divider high 16 bits
0x11C PWM_DUTY_L0 — PWM0 duty cycle low 16 bits
  [15:0] pwm_duty_l_0
0x120 PWM_DUTY_H0 — PWM0 duty cycle high 16 bits
  [15:0] pwm_duty_h_0
0x124 PWM_PERIODLOAD_FLAG0 ro — PWM0 period load flag
  [0] pwm_periodload_flag_0 — Period load complete flag
0x128 PWM_PERIOD_VAL0 — PWM0 pulse count value
  [15:0] pwm_period_val_0 — Pulse count for stepping mode
0x12C PWM_PERIODCNT0 ro — PWM0 pulse count current value
  [15:0] pwm_periodcnt_0 — Current pulse count
0x140 PWM_EN1 — PWM1 enable
  [0] pwm_en_1
0x144 PWM_PORTITY1 — PWM1 polarity
  [0] pwm_poarity_1
0x148 PWM_OEN_CFG1 — PWM1 high-impedance config
  [0] pwm_oen_cfg_1 — PWM1 high-Z enable
0x14C PWM_OFFSET_L1 — PWM1 phase offset low
  [15:0] pwm_offset_l_1 — PWM1 phase offset low 16 bits
0x150 PWM_OFFSET_H1 — PWM1 phase offset high
  [15:0] pwm_offset_h_1 — PWM1 phase offset high 16 bits
0x154 PWM_FREQ_L1 — PWM1 frequency low
  [15:0] pwm_freq_l_1 — PWM1 clock divider low 16 bits
0x158 PWM_FREQ_H1 — PWM1 frequency high
  [15:0] pwm_freq_h_1 — PWM1 clock divider high 16 bits
0x15C PWM_DUTY_L1 — PWM1 duty cycle low
  [15:0] pwm_duty_l_1 — PWM1 duty low 16 bits
0x160 PWM_DUTY_H1 — PWM1 duty cycle high
  [15:0] pwm_duty_h_1 — PWM1 duty high 16 bits
0x164 PWM_PERIODLOAD_FLAG1 ro — PWM1 period load flag
  [0] pwm_periodload_flag_1 — Period load flag
0x168 PWM_PERIOD_VAL1 — PWM1 pulse count
  [15:0] pwm_period_val_1 — Pulse count
0x16C PWM_PERIODCNT1 ro — PWM1 pulse count current
  [15:0] pwm_periodcnt_1 — Current pulse count
{0x100+0x40*i} PWM_EN{i} (i=2..7) — PWM{i} enable
  [0] pwm_en_{i} — PWM0 enable: 0=off; 1=on
    0=Off (PWM disabled, output low); 1=On (PWM enabled)
{0x104+0x40*i} PWM_PORTITY{i} (i=2..7) — PWM{i} polarity
  [0] pwm_poarity_{i} — PWM0 polarity: 0=normal; 1=inverted
    0=Normal polarity; 1=Inverted polarity
{0x108+0x40*i} PWM_OEN_CFG{i} (i=2..7) — PWM{i} high-impedance config
  [0] pwm_oen_cfg_{i} — PWM0 high-Z enable: 0=follow polarity; 1=high-Z when inactive
{0x10C+0x40*i} PWM_OFFSET_L{i} (i=2..7) — PWM{i} phase offset low 16 bits
  [15:0] pwm_offset_l_{i} — PWM0 phase offset low 16 bits
{0x110+0x40*i} PWM_OFFSET_H{i} (i=2..7) — PWM{i} phase offset high 16 bits
  [15:0] pwm_offset_h_{i} — PWM0 phase offset high 16 bits
{0x114+0x40*i} PWM_FREQ_L{i} (i=2..7) — PWM{i} frequency low 16 bits
  [15:0] pwm_freq_l_{i} — PWM0 clock divider low 16 bits
{0x118+0x40*i} PWM_FREQ_H{i} (i=2..7) — PWM{i} frequency high 16 bits
  [15:0] pwm_freq_h_{i} — PWM0 clock divider high 16 bits
{0x11C+0x40*i} PWM_DUTY_L{i} (i=2..7) — PWM{i} duty cycle low 16 bits
  [15:0] pwm_duty_l_{i} — PWM0 duty cycle low 16 bits
{0x120+0x40*i} PWM_DUTY_H{i} (i=2..7) — PWM{i} duty cycle high 16 bits
  [15:0] pwm_duty_h_{i} — PWM0 duty cycle high 16 bits
{0x124+0x40*i} PWM_PERIODLOAD_FLAG{i} ro (i=2..7) — PWM{i} period load flag
  [0] pwm_periodload_flag_{i} — Period load complete flag
{0x128+0x40*i} PWM_PERIOD_VAL{i} (i=2..7) — PWM{i} pulse count value
  [15:0] pwm_period_val_{i} — Pulse count for stepping mode
{0x12C+0x40*i} PWM_PERIODCNT{i} ro (i=2..7) — PWM{i} pulse count current value
  [15:0] pwm_periodcnt_{i} — Current pulse count
0x500 PWM_ABNOR_STATE0 ro — PWM abnormal state register 0
  [15:0] pwm_abnor_state0 — Multi-channel config abnormal state, each bit per PWM
0x504 PWM_ABNOR_STATE1 ro — PWM abnormal state register 1
  [15:0] pwm_abnor_state1 — Counter config abnormal state, each bit per PWM
0x508 PWM_ABNOR_STATE_CLR0 wo — PWM abnormal state clear 0
  [15:0] pwm_abnor_state_clr0 — Clear abnormal state 0 (self-clearing)
0x50C PWM_ABNOR_STATE_CLR1 wo — PWM abnormal state clear 1
  [15:0] pwm_abnor_state_clr1 — Clear abnormal state 1 (self-clearing)
0x510 PWM_INT_MASK — PWM interrupt mask
  [1:0] pwm_int_mask — Interrupt mask: bit[0]=abnormal; bit[1]=stepping cycle end
0x514 PWM_DMA_EN — PWM DMA enable
  [0] pwm_dma_en — DMA enable: 0=disabled; 1=enabled
0x518 PWM_CFG_INT_CLR0 wo — PWM stepping cycle end interrupt clear
  [15:0] pwm_cfg_int_clr0 — Stepping cycle end interrupt clear (self-clearing)

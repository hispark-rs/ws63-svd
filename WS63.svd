# WS63 register map
File version: 1.0
HiSilicon WS63 Wi-Fi/BLE/SLE Combo SoC — ISA: rv32i2p1_m2p0_f2p2_c2p0_zicsr2p0 (RV32IMFC_Zicsr), 240MHz, 512KB ITCM, 288KB DTCM, 640KB shared SRAM
CPU: other r0p0, little endian, MPU, FPU, 3 interrupt priority bits
Registers are 32-bit, read-write, reset 0x0 unless marked. A register's access mark holds for its fields unless they carry their own. Offsets are from the block's base; lines under a group give offsets from that group; [hi:lo] are bit positions; {n}, {i} and the like mark numbered series; 'fields as' and 'values as' point back to an identical list; <NAME> marks a mode.

## Memory map
0x40000000 SYS_CTL0 size 0x4000 — System Control 0 - reset status, clock control, PLL config
0x40002000 GLB_CTL_M size 0x200 — Main core global control - BCPU/MCPU reset status, chip reset, AON CRG
0x40003000 CMU size 0x500 — Clock management unit registers used by WS63 clock and PLL setup
0x40006000 WDT size 0x1000 — Watchdog timer (v151)
0x44000000 SYS_CTL1 size 0x2000 — System Control 1 - Interrupt Controller
0x440004C0 TCXO size 0x20 — TCXO 64-bit free-running counter (v150)
0x44001100 CLDO_CRG size 0x100 — CLDO Clock and Reset Generator - clock enables, dividers, clock selects, soft resets
0x44002000 TIMER size 0x1000 — Timer module with 3 independent 32-bit timers (v150)
0x44004000 RF_WB_CTL size 0x100 — SYS_CTL2 sub-block: RF Wideband Control Register Block - WL/BT RF analog interface control
0x44006C00 SHARE_MEM_CTL size 0x100 — SYS_CTL2 sub-block: Shared Memory Control - RAM config, RX/TX DMA descriptor rings for WiFi PHY↔Packet buffer
0x44007800 FAMA_REMAP size 0x100 — SYS_CTL2 sub-block: Flash Address Map Remap - up to 12 regions for boot-time address redirection
0x44008000 EFUSE size 0x4000 — eFuse controller (OTP, v151)
0x4400C000 LSADC size 0x1000 — Low-speed ADC controller (12-bit SAR, 6 channels, v154)
0x4400D000 IO_CONFIG size 0x1000 — IO multiplexing and pad control
0x4400E000 TSENSOR size 0x1000 — Temperature sensor controller (v151)
0x44010000 UART0 size 0x1000 — UART0 - Universal Asynchronous Receiver/Transmitter
0x44011000 UART1 size 0x1000 — UART1 with flow control support
0x44012000 UART2 size 0x1000 — UART2 with flow control support
0x44018000 I2C0 size 0x100 — I2C0 master controller
0x44018100 I2C1 size 0x100 — I2C1 master controller
0x44020000 SPI0 size 0x100 — SPI0 master/slave controller (SSI v151)
0x44021000 SPI1 size 0x100 — SPI1/QSPI controller (SSI v151)
0x44024000 PWM size 0x1000 — PWM controller with 8 channels
0x44025000 I2S size 0x100 — I2S/SIO synchronous audio interface (v151)
0x44028000 GPIO0 size 0x1000 — GPIO controller for GPIO[7:0]
0x44029000 GPIO1 size 0x1000 — GPIO controller for GPIO[15:8]
0x4402A000 GPIO2 size 0x1000 — GPIO controller for GPIO[18:16] — only 3 bits used; bits [7:3] are reserved and unused.
0x44100000 SPACC size 0x10000 — Security accelerator - AES/SM4/LEA/TDES symmetric crypto, HASH/HMAC
0x44110000 PKE size 0x2000 — Public Key Engine - modular arithmetic accelerator
0x44112000 KM size 0x2000 — Key Management - KLAD key derivation, keyslot locking, RKP root key protection
0x44114000 TRNG size 0x1000 — True Random Number Generator
0x44210000 WLMAC_STATS size 0xB44 — Read-only Wi-Fi MAC receive statistics used by the WS63 mask-ROM hh503_get_mac_rx_statistics_data implementation
0x48000000 SFC_CFG size 0x2000 — SPI Flash Controller configuration
0x49003000 BT_EM_CTL size 0x100 — Bluetooth exchange-memory control used while changing shared RAM ownership
0x4A000000 DMA size 0x1000 — DMA controller with 4 channels
0x520A0000 SDMA size 0x1000 — Secure DMA controller (4 channels, same layout as MDMA v151). Channels logically mapped as 8-11.
0x57024000 RTC size 0x100 — Real-time clock (48-bit free-running counter, v100)
0x57030000 ULP_GPIO size 0x1000 — Ultra-low-power GPIO controller (8 pins, GPIO[107:114]). Same register layout as GPIO0.
0xE0000000 RISCV_PATCH size 0x310 — RISC-V instruction patch controller used to redirect mask-ROM entry points to application-provided fixes

## Interrupts
26 TIMER_INT0 (SYS_CTL1)
27 TIMER_INT1 (SYS_CTL1)
28 TIMER_INT2 (SYS_CTL1)
29 RTC_IRQ (RTC)
31 I2C0_INT (I2C0)
32 I2C1_INT (I2C1)
33 GPIO_INT0 (GPIO0)
34 GPIO_INT1 (GPIO1)
35 GPIO_INT2 (GPIO2)
36 SOFT_INT0 (SYS_CTL1)
37 SOFT_INT1 (SYS_CTL1)
38 SOFT_INT2 (SYS_CTL1)
39 SOFT_INT3 (SYS_CTL1)
40 COEX_WL_INT (SYS_CTL1)
41 COEX_BT_INT (SYS_CTL1)
42 COEX_WIFI_RESUME_INT (SYS_CTL1)
43 SPI_INT (SPI0)
44 WLPHY_INT (SYS_CTL1)
45 WLMAC_INT (SYS_CTL1)
46 BLE_INT (SYS_CTL1)
47 GLE_INT (SYS_CTL1) — BGLE baseband interrupt (BT_BB_GLE_IRQN in the vendor SDK)
48 TSENSOR_INT (TSENSOR)
49 PMU_CMU_ERR_INT (GLB_CTL_M)
50 DIAG_INT (GLB_CTL_M)
51 I2S_INT (I2S)
52 QSPI_INT (SPI1)
53 UART0_INT (UART0)
54 UART1_INT (UART1)
55 UART2_INT (UART2)
56 PWM_ABNOR_INT (PWM)
57 PWM_CFG_INT (PWM)
58 SFC_INT (SFC_CFG)
59 DMA_INT (DMA)
60 TIMER_ABNOR_INT (TIMER)
61 I2S_TX_INT (I2S)
62 I2S_RX_INT (I2S)
63 PKE_REE_INT (PKE)
64 SPACC_REE_INT (SPACC)
65 RKP_REE_INT (SPACC)
66 KLAD_REE_INT (KM)
67 GLP_UART_RX_WAKE_INT (SYS_CTL1)
68 TIMING_GEN_INT (SYS_CTL1)
69 MAC_MONITOR_INT (GLB_CTL_M)
70 MEM_MONITOR_INT (GLB_CTL_M)
71 TCM_MONITOR_INT (GLB_CTL_M)
72 LSADC_INTR (LSADC)

## Licence text in the file
Register definitions derived from public ws63-guide documentation and fbb_ws63 HAL headers. See https://github.com/hispark-rs/ws63-guide and https://github.com/hispark-rs/ws63-svd
